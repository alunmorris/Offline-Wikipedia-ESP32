// Written by Alun Morris and Claude Code
#include "wiki_db.h"
#include "config.h"

extern "C" {
#include "lz4.h"
}

#include <SD.h>
#include <SPI.h>
#include <LittleFS.h>

// ---------------------------------------------------------------------------
// Sparse index — loaded from sparse_index.bin (generated by the preprocessor).
// One entry per SPARSE_STEP records.  Stored in heap at init.
// Eliminates all SD seeks from the binary-search phase of wikiDbSearch.
// For 200 K articles: 3125 × 12 B = ~37 KB on the heap.
// SPARSE_STEP and SPARSE_KEY_LEN are defined in config.h (shared with preprocessor).
// ---------------------------------------------------------------------------

static char    (*g_sparse_keys)[SPARSE_KEY_LEN] = nullptr;
static uint32_t  g_sparse_count = 0;

// ---------------------------------------------------------------------------
// Module-level state
// ---------------------------------------------------------------------------

static uint32_t g_article_count = 0;
static uint32_t g_sparse_step   = SPARSE_STEP_DEFAULT;   // overridden from index_meta.txt
static String   g_db_name;
static bool     g_initialised   = false;

// Static scratch buffer for image loading (JPEG and QOI).
static uint8_t g_jpeg_buf[IMG_BUF_SIZE];

// Persistent decompression buffer — allocated once at init on a clean heap and reused
// for every article load.  Eliminates per-article malloc fragmentation for large articles.
static uint8_t *g_decomp_buf      = nullptr;
static size_t   g_decomp_buf_size = 0;

// File handles kept open across calls to avoid repeated open/close overhead.
static File     g_index_file;
static File     g_id_index_file;
// Chunk file cache: keep the most-recently-used chunk open to avoid open/close on every request.
static File     g_chunk_file;
static uint32_t g_open_chunk_id = UINT32_MAX;

// Word index (optional) — NOT kept open; opened/closed per search call to save FDs.
static uint32_t g_word_entry_count        = 0;
static uint32_t g_word_ids_section_offset = 0;

// Image database (optional — absent when ZIM was built with --no-images)
static File     g_img_index_file;
static File     g_img_chunk_file;
static uint32_t g_open_img_chunk_id  = UINT32_MAX;
static bool     g_images_available   = false;
static uint32_t g_image_count        = 0;

// ---------------------------------------------------------------------------
// Helpers
// ---------------------------------------------------------------------------

// Read a null-padded, fixed-width field from the current file position.
static String readFixedString(File &f, size_t fieldLen) {
    // Stack-allocate with a compile-time constant max to avoid VLA.
    char buf[TITLE_KEY_LEN + 1];
    if (fieldLen > TITLE_KEY_LEN) fieldLen = TITLE_KEY_LEN;
    f.read((uint8_t *)buf, fieldLen);
    buf[fieldLen] = '\0';
    return String(buf);   // String() stops at the first '\0'
}

static uint32_t readU32LE(File &f) {
    uint8_t b[4] = {0, 0, 0, 0};
    size_t got = 0;
    while (got < 4) {
        int n = f.read(b + got, 4 - got);
        if (n <= 0) break;
        got += n;
    }
    return (uint32_t)b[0]
         | ((uint32_t)b[1] << 8)
         | ((uint32_t)b[2] << 16)
         | ((uint32_t)b[3] << 24);
}

// Read exactly len bytes from f into buf, retrying on short reads.
static bool readExact(File &f, uint8_t *buf, size_t len) {
    size_t got = 0;
    while (got < len) {
        int n = f.read(buf + got, len - got);
        if (n <= 0) return false;
        got += n;
    }
    return true;
}

static uint16_t readU16LE(const uint8_t *p) {
    return (uint16_t)p[0] | ((uint16_t)p[1] << 8);
}

static uint32_t readU32LE_buf(const uint8_t *p) {
    return (uint32_t)p[0]
         | ((uint32_t)p[1] << 8)
         | ((uint32_t)p[2] << 16)
         | ((uint32_t)p[3] << 24);
}

// Normalise a title for index comparison: lowercase + trim whitespace.
static String normaliseKey(const String &s) {
    String out = s;
    out.trim();
    out.toLowerCase();
    return out;
}

// ---------------------------------------------------------------------------
// LittleFS sparse-index cache
//
// File layout: [article_count uint32 LE][sparse_step uint32 LE][keys...]
// The 8-byte header lets us detect a stale cache (different dataset / step).
// ---------------------------------------------------------------------------

static bool tryLoadSparseFromFlash() {
    if (!LittleFS.begin(false)) return false;   // don't format — not there yet

    bool ok = false;
    File f = LittleFS.open(FLASH_SPARSE_PATH, "r");
    if (f && f.size() > 8) {
        struct { uint32_t count; uint32_t step; } hdr;
        if (f.read((uint8_t *)&hdr, 8) == 8
            && hdr.count == g_article_count
            && hdr.step  == g_sparse_step) {

            uint32_t data_len = (uint32_t)f.size() - 8;
            if (data_len % SPARSE_KEY_LEN == 0) {
                g_sparse_count = data_len / SPARSE_KEY_LEN;
                g_sparse_keys  = (char (*)[SPARSE_KEY_LEN]) malloc(data_len);
                if (g_sparse_keys
                    && (uint32_t)f.read((uint8_t *)g_sparse_keys, data_len) == data_len) {
                    Serial.printf("[wiki_db] Sparse index: %u entries from flash cache\n",
                                  g_sparse_count);
                    ok = true;
                } else {
                    free(g_sparse_keys); g_sparse_keys = nullptr; g_sparse_count = 0;
                }
            }
        } else if (f.size() > 8) {
            // Header mismatch — stale cache; will be overwritten after SD load
            struct { uint32_t count; uint32_t step; } h2 = {};
            f.seek(0); f.read((uint8_t*)&h2, 8);
            Serial.printf("[wiki_db] Flash cache stale (count=%u step=%u) — reloading from SD\n",
                          h2.count, h2.step);
        }
    }
    if (f) f.close();
    LittleFS.end();
    return ok;
}

static void saveSparseToFlash() {
    if (!g_sparse_keys || g_sparse_count == 0) return;
    if (!LittleFS.begin(true)) {   // true = format partition if first use
        Serial.println("[wiki_db] LittleFS.begin() failed — sparse index not cached");
        return;
    }
    File f = LittleFS.open(FLASH_SPARSE_PATH, "w");
    if (!f) {
        Serial.println("[wiki_db] Cannot write " FLASH_SPARSE_PATH);
        LittleFS.end();
        return;
    }
    struct { uint32_t count; uint32_t step; } hdr = { g_article_count, g_sparse_step };
    f.write((uint8_t *)&hdr, 8);
    f.write((const uint8_t *)g_sparse_keys, g_sparse_count * SPARSE_KEY_LEN);
    f.close();
    LittleFS.end();
    Serial.printf("[wiki_db] Sparse index cached to flash (%u bytes)\n",
                  8 + g_sparse_count * SPARSE_KEY_LEN);
}

// ---------------------------------------------------------------------------
// Public API
// ---------------------------------------------------------------------------

// Grab the decompression buffer before the heap gets fragmented.
// Call once at the very top of setup(), before displayInit() / SD.begin() etc.
void wikiDbPreInit() {
    if (g_decomp_buf) return;   // already done
    Serial.printf("[wiki_db] pre-init: free=%u max_block=%u\n",
                  ESP.getFreeHeap(), ESP.getMaxAllocHeap());
    size_t try_size = 200 * 1024;
    while (try_size >= 80 * 1024) {
        g_decomp_buf = (uint8_t *)malloc(try_size);
        if (g_decomp_buf) { g_decomp_buf_size = try_size; break; }
        try_size -= 8 * 1024;
    }
    if (!g_decomp_buf)
        Serial.println("[wiki_db] WARNING: decomp buffer alloc failed — large articles may not load");
    else
        Serial.printf("[wiki_db] Decomp buffer: %u bytes (free after: %u)\n",
                      (unsigned)g_decomp_buf_size, ESP.getFreeHeap());
}

bool wikiDbInit() {
    SPI.begin(SD_SCK, SD_MISO, SD_MOSI, SD_CS);
    if (!SD.begin(SD_CS, SPI, 48000000)) {  // 48 MHz
        Serial.println("[wiki_db] SD.begin() failed");
        return false;
    }

    // Read article count from index_meta.txt
    File meta = SD.open(META_PATH, FILE_READ);
    if (!meta) {
        Serial.println("[wiki_db] Cannot open " META_PATH);
        return false;
    }
    while (meta.available()) {
        String line = meta.readStringUntil('\n');
        line.trim();
        if (line.startsWith("article_count=")) {
            g_article_count = line.substring(14).toInt();
        } else if (line.startsWith("sparse_step=")) {
            uint32_t v = (uint32_t)line.substring(12).toInt();
            if (v > 0) g_sparse_step = v;
        } else if (line.startsWith("db_name=")) {
            g_db_name = line.substring(8);
        }
    }
    meta.close();

    if (g_article_count == 0) {
        Serial.println("[wiki_db] article_count not found or zero in meta");
        return false;
    }

    // Open persistent file handles
    g_index_file = SD.open(INDEX_PATH, FILE_READ);
    if (!g_index_file) {
        Serial.println("[wiki_db] Cannot open " INDEX_PATH);
        return false;
    }

    g_id_index_file = SD.open(ID_INDEX_PATH, FILE_READ);
    if (!g_id_index_file) {
        Serial.println("[wiki_db] Cannot open " ID_INDEX_PATH);
        g_index_file.close();
        return false;
    }

    // Open chunk 0 eagerly so the first article load is fast.
    {
        char path[32];
        snprintf(path, sizeof(path), ARTICLES_CHUNK_FMT, 0u);
        g_chunk_file = SD.open(path, FILE_READ);
        if (!g_chunk_file) {
            Serial.printf("[wiki_db] Cannot open %s\n", path);
            g_index_file.close();
            g_id_index_file.close();
            return false;
        }
        g_open_chunk_id = 0;
    }

    // Word index (optional) — read header only (3 FDs open here: index+id_index+chunk).
    // Must happen BEFORE img files open (which fills the remaining 2 FD slots).
    {
        File wf = SD.open(WORD_INDEX_PATH, FILE_READ);
        if (wf) {
            uint8_t hdr[8];
            if (wf.read(hdr, 8) == 8) {
                g_word_entry_count        = readU32LE_buf(hdr);
                g_word_ids_section_offset = readU32LE_buf(hdr + 4);
                Serial.printf("[wiki_db] Word index: %u words, ids_offset=%u\n",
                              g_word_entry_count, g_word_ids_section_offset);
            } else {
                Serial.println("[wiki_db] Word index: header read failed");
            }
            wf.close();
        } else {
            Serial.printf("[wiki_db] Word index not found at %s\n", WORD_INDEX_PATH);
        }
    }

    // Try to open the optional image database (fills FD slots 4 and 5).
    // img_meta.txt is absent for _pictures:no ZIM builds — handle gracefully.
    {
        File img_meta = SD.open(IMG_META_PATH, FILE_READ);
        if (img_meta) {
            while (img_meta.available()) {
                String line = img_meta.readStringUntil('\n');
                line.trim();
                if (line.startsWith("image_count=")) {
                    uint32_t v = (uint32_t)line.substring(12).toInt();
                    if (v > 0) g_image_count = v;
                }
            }
            img_meta.close();
        }
        if (g_image_count > 0) {
            g_img_index_file = SD.open(IMG_INDEX_PATH, FILE_READ);
            if (g_img_index_file) {
                char img_c0[32];
                snprintf(img_c0, sizeof(img_c0), IMG_CHUNK_FMT, 0u);
                g_img_chunk_file = SD.open(img_c0, FILE_READ);
                if (g_img_chunk_file) {
                    g_open_img_chunk_id = 0;
                    g_images_available = true;
                    Serial.printf("[wiki_db] Images: %u available\n", g_image_count);
                } else {
                    Serial.println("[wiki_db] img_0000.dat missing — images disabled");
                    g_img_index_file.close();
                }
            } else {
                Serial.println("[wiki_db] img_index.bin missing — images disabled");
            }
        }
    }

    // Load sparse index: flash cache first (zero SD access), SD fallback + re-cache.
    if (!tryLoadSparseFromFlash()) {
        File sf = SD.open(SPARSE_INDEX_PATH, FILE_READ);
        if (sf) {
            uint32_t file_bytes = sf.size();
            g_sparse_count = file_bytes / SPARSE_KEY_LEN;
            g_sparse_keys  = (char (*)[SPARSE_KEY_LEN]) malloc(g_sparse_count * SPARSE_KEY_LEN);
            if (g_sparse_keys) {
                sf.read((uint8_t *)g_sparse_keys, g_sparse_count * SPARSE_KEY_LEN);
                Serial.printf("[wiki_db] Sparse index: %u entries from SD (step=%u)\n",
                              g_sparse_count, g_sparse_step);
                saveSparseToFlash();   // cache for next boot
            } else {
                Serial.println("[wiki_db] WARNING: sparse index malloc failed — falling back to full binary search");
                g_sparse_count = 0;
            }
            sf.close();
        } else {
            Serial.println("[wiki_db] WARNING: " SPARSE_INDEX_PATH " not found — falling back to full binary search");
            g_sparse_count = 0;
        }
    }

    // Allocate decompression buffer if wikiDbPreInit() wasn't called.
    // Prefer calling wikiDbPreInit() early in setup() for best results.
    Serial.printf("[wiki_db] init: free=%u max_block=%u decomp_buf=%u\n",
                  ESP.getFreeHeap(), ESP.getMaxAllocHeap(), (unsigned)g_decomp_buf_size);
    if (!g_decomp_buf) {
        size_t try_size = 200 * 1024;
        while (try_size >= 80 * 1024) {
            g_decomp_buf = (uint8_t *)malloc(try_size);
            if (g_decomp_buf) { g_decomp_buf_size = try_size; break; }
            try_size -= 8 * 1024;
        }
        if (!g_decomp_buf)
            Serial.println("[wiki_db] WARNING: decomp buffer alloc failed — large articles may not load");
        else
            Serial.printf("[wiki_db] Decomp buffer (late alloc): %u bytes\n", (unsigned)g_decomp_buf_size);
    }

    g_initialised = true;
    Serial.printf("[wiki_db] Ready: %u articles\n", g_article_count);
    return true;
}

uint32_t wikiDbArticleCount() {
    return g_article_count;
}

const String &wikiDbName() {
    return g_db_name;
}

// ---------------------------------------------------------------------------
// Binary search index.bin for an exact title_key
// ---------------------------------------------------------------------------
uint32_t wikiDbFindByTitle(const String &title_key) {
    if (!g_initialised) return UINT32_MAX;

    String key = normaliseKey(title_key);

    int32_t lo = 0;
    int32_t hi = (int32_t)g_article_count - 1;

    while (lo <= hi) {
        int32_t mid = lo + (hi - lo) / 2;

        g_index_file.seek((uint32_t)mid * INDEX_RECORD_SIZE);

        char title_buf[TITLE_KEY_LEN + 1];
        g_index_file.read((uint8_t *)title_buf, TITLE_KEY_LEN);
        title_buf[TITLE_KEY_LEN] = '\0';
        String rec_key = String(title_buf);

        int cmp = key.compareTo(rec_key);
        if (cmp == 0) {
            // Found — read article_id (next 4 bytes)
            return readU32LE(g_index_file);
        } else if (cmp < 0) {
            hi = mid - 1;
        } else {
            lo = mid + 1;
        }
    }
    return UINT32_MAX;
}

// ---------------------------------------------------------------------------
// Load one page-block of an article.  Supports two on-disk formats:
//
//   WKI2 (new, multi-block):
//     Chunk file blob: WKI2[4] id[4] title_len[2] title[N] num_blocks[2]
//                      repeated: compressed_len[4] lz4_data[compressed_len]
//     lz4_data starts with 4-byte original_size (lz4.block store_size=True).
//     block_num selects which block (= page) to decompress.
//     result.pre_paged = true; result.html is the block's HTML.
//
//   WIKI (old, single-block):
//     Chunk file blob: original_size[4] LZ4_block[blob_len - 4]
//     LZ4_block decompresses to: WIKI[4] id[4] title_len[2] title html_len[4] html
//     block_num is ignored; full HTML returned for client-side paging.
//     result.pre_paged = false.
// ---------------------------------------------------------------------------
ArticleResult wikiDbLoadArticle(uint32_t article_id, uint16_t block_num) {
    ArticleResult result;
    if (!g_initialised) return result;

    if (article_id >= g_article_count) {
        Serial.printf("[wiki_db] article_id %u out of range (%u)\n", article_id, g_article_count);
        return result;
    }

    if (!g_id_index_file.seek(article_id * 12)) {
        Serial.printf("[wiki_db] id_index seek failed for id=%u\n", article_id);
        return result;
    }
    uint32_t chunk_id = readU32LE(g_id_index_file);
    uint32_t offset   = readU32LE(g_id_index_file);
    uint32_t blob_len = readU32LE(g_id_index_file);
    Serial.printf("[wiki_db] id=%u chunk=%u offset=%u len=%u blk=%u\n",
                  article_id, chunk_id, offset, blob_len, block_num);

    if (chunk_id != g_open_chunk_id) {
        g_chunk_file.close();
        char path[32];
        snprintf(path, sizeof(path), ARTICLES_CHUNK_FMT, chunk_id);
        g_chunk_file = SD.open(path, FILE_READ);
        if (!g_chunk_file) {
            Serial.printf("[wiki_db] Cannot open chunk %s\n", path);
            g_open_chunk_id = UINT32_MAX;
            return result;
        }
        g_open_chunk_id = chunk_id;
    }

    g_chunk_file.seek(offset);

    if (!g_decomp_buf) {
        Serial.println("[wiki_db] No decompression buffer");
        return result;
    }

    // Read first 4 bytes to detect format
    uint8_t first4[4];
    if (!readExact(g_chunk_file, first4, 4)) {
        Serial.printf("[wiki_db] magic read failed: id=%u\n", article_id);
        return result;
    }

    // ---- Helper lambda: in-place LZ4 decompress (compressed at buf end → output at start) ----
    auto inplace_decompress = [&](uint32_t lz4_block_len, uint32_t original_size) -> int {
        uint32_t margin = (lz4_block_len >> 8) + 32;
        if (original_size + margin + lz4_block_len > (uint32_t)g_decomp_buf_size) {
            Serial.printf("[wiki_db] too large: orig=%u comp=%u need=%u buf=%u\n",
                          original_size, lz4_block_len,
                          original_size + margin + lz4_block_len,
                          (unsigned)g_decomp_buf_size);
            return -1;
        }
        uint8_t *lz4_src = g_decomp_buf + g_decomp_buf_size - lz4_block_len;
        if (!readExact(g_chunk_file, lz4_src, lz4_block_len)) {
            Serial.printf("[wiki_db] block read failed: id=%u\n", article_id);
            return -1;
        }
        return LZ4_decompress_safe(
            (const char *)lz4_src, (char *)g_decomp_buf,
            (int)lz4_block_len, (int)original_size);
    };

    if (memcmp(first4, "WKI2", 4) == 0) {
        // ---- WKI2 multi-block format ----

        // article_id
        uint8_t id_buf[4];
        if (!readExact(g_chunk_file, id_buf, 4)) return result;
        result.article_id = readU32LE_buf(id_buf);

        // title
        uint8_t tl_buf[2];
        if (!readExact(g_chunk_file, tl_buf, 2)) return result;
        uint16_t title_len = readU16LE(tl_buf);
        {
            char tmp[512];
            uint16_t tl = title_len < 511 ? title_len : 511;
            if (!readExact(g_chunk_file, (uint8_t *)tmp, tl)) return result;
            tmp[tl] = '\0';
            result.title = String(tmp, tl);
            if (title_len > 511)
                g_chunk_file.seek(g_chunk_file.position() + (title_len - 511));
        }

        // num_blocks
        uint8_t nb_buf[2];
        if (!readExact(g_chunk_file, nb_buf, 2)) return result;
        uint16_t num_blocks = readU16LE(nb_buf);

        if (block_num >= num_blocks) {
            Serial.printf("[wiki_db] block %u >= num_blocks %u\n", block_num, num_blocks);
            return result;
        }

        // Skip blocks 0..block_num-1
        for (uint16_t b = 0; b < block_num; b++) {
            uint8_t cl_buf[4];
            if (!readExact(g_chunk_file, cl_buf, 4)) return result;
            uint32_t skip = readU32LE_buf(cl_buf);
            if (!g_chunk_file.seek(g_chunk_file.position() + skip)) return result;
        }

        // Read target block
        uint8_t cl_buf[4];
        if (!readExact(g_chunk_file, cl_buf, 4)) return result;
        uint32_t compressed_len = readU32LE_buf(cl_buf);
        uint32_t lz4_block_len  = compressed_len - 4;

        uint8_t hdr4[4];
        if (!readExact(g_chunk_file, hdr4, 4)) return result;
        uint32_t original_size = readU32LE_buf(hdr4);

        int decomp_len = inplace_decompress(lz4_block_len, original_size);
        if (decomp_len < 0) return result;

        result.html       = (char *)g_decomp_buf;
        result.html_len   = (uint32_t)decomp_len;
        result.num_blocks = num_blocks;
        result.block_num  = block_num;
        result.pre_paged  = true;
        result.found      = true;

    } else {
        // ---- Old WIKI single-block format ----
        // first4 = original_size (4-byte LE prefix that precedes the LZ4 block)

        uint32_t original_size = readU32LE_buf(first4);
        uint32_t lz4_block_len = blob_len - 4;

        int decomp_len = inplace_decompress(lz4_block_len, original_size);
        if (decomp_len < 0) return result;

        // Parse WIKI blob: WIKI[4] id[4] title_len[2] title html_len[4] html
        const uint8_t *p   = g_decomp_buf;
        const uint8_t *end = p + decomp_len;
        auto check = [&](size_t n) -> bool { return (p + n) <= end; };

        if (!check(4) || memcmp(p, "WIKI", 4) != 0) {
            Serial.printf("[wiki_db] WIKI bad magic: %02X%02X%02X%02X\n",
                          p[0], p[1], p[2], p[3]);
            return result;
        }
        p += 4;
        if (!check(4)) return result;
        result.article_id = readU32LE_buf(p); p += 4;
        if (!check(2)) return result;
        uint16_t title_len = readU16LE(p); p += 2;
        if (!check(title_len)) return result;
        result.title = String((const char *)p, title_len); p += title_len;
        if (!check(4)) return result;
        uint32_t html_len = readU32LE_buf(p); p += 4;
        if (!check(html_len)) return result;

        result.html       = (char *)p;
        result.html_len   = html_len;
        result.num_blocks = 1;    // old format: caller does byte-slicing for pages
        result.block_num  = 0;
        result.pre_paged  = false;
        result.found      = true;
    }

    return result;
}

// ---------------------------------------------------------------------------
// Prefix search — sparse-index fast path + single-seek sequential scan
// ---------------------------------------------------------------------------
std::vector<SearchResult> wikiDbSearch(const String &prefix, int maxResults) {
    std::vector<SearchResult> results;
    if (!g_initialised || prefix.length() == 0) return results;

    String norm_prefix = normaliseKey(prefix);
    const char *npfx  = norm_prefix.c_str();
    int         pfxLen = (int)norm_prefix.length();

    // ---- Step 1: locate scan start ----------------------------------------
    int32_t start_rec;

    if (g_sparse_keys && g_sparse_count > 0) {
        // Binary search the sparse index entirely in RAM — zero SD seeks.
        int cmpLen = pfxLen < SPARSE_KEY_LEN ? pfxLen : SPARSE_KEY_LEN;
        int32_t lo = 0, hi = (int32_t)g_sparse_count - 1;
        int32_t sp = 0;  // last sparse entry strictly < prefix
        while (lo <= hi) {
            int32_t mid = lo + (hi - lo) / 2;
            if (strncmp(g_sparse_keys[mid], npfx, cmpLen) < 0) {
                sp = mid + 1;
                lo = mid + 1;
            } else {
                hi = mid - 1;
            }
        }
        // sp is the first sparse entry >= prefix; back up one block to be safe.
        start_rec = (sp > 1 ? sp - 1 : 0) * (int32_t)g_sparse_step;
    } else {
        // Fallback: full binary search on SD (original behaviour).
        int32_t lo = 0, hi = (int32_t)g_article_count - 1;
        int32_t first = (int32_t)g_article_count;
        while (lo <= hi) {
            int32_t mid = lo + (hi - lo) / 2;
            g_index_file.seek((uint32_t)mid * INDEX_RECORD_SIZE);
            char title_buf[TITLE_KEY_LEN + 1];
            g_index_file.read((uint8_t *)title_buf, TITLE_KEY_LEN);
            title_buf[TITLE_KEY_LEN] = '\0';
            if (strncmp(title_buf, npfx, pfxLen) < 0) { lo = mid + 1; }
            else                                        { first = mid; hi = mid - 1; }
        }
        start_rec = first;
    }

    if (start_rec >= (int32_t)g_article_count) return results;

    // ---- Step 2: single seek then pure sequential reads -------------------
    // No per-record seeks — the file pointer advances naturally.
    g_index_file.seek((uint32_t)start_rec * INDEX_RECORD_SIZE);

    // Tail of each record beyond (title_key + article_id)
    constexpr int TAIL = INDEX_RECORD_SIZE - TITLE_KEY_LEN - 4;

    for (int32_t i = start_rec;
         i < (int32_t)g_article_count && (int)results.size() < maxResults;
         i++)
    {
        char title_buf[TITLE_KEY_LEN + 1];
        g_index_file.read((uint8_t *)title_buf, TITLE_KEY_LEN);
        title_buf[TITLE_KEY_LEN] = '\0';

        int cmp = strncmp(title_buf, npfx, pfxLen);

        if (cmp < 0) {
            // Before the prefix range — consume rest of record and continue.
            uint8_t skip[INDEX_RECORD_SIZE - TITLE_KEY_LEN];
            g_index_file.read(skip, sizeof(skip));
            continue;
        }
        if (cmp > 0) break;   // past prefix range — done

        // Match: read article_id then consume record tail.
        uint8_t id_buf[4];
        g_index_file.read(id_buf, 4);
        uint8_t tail[TAIL];
        g_index_file.read(tail, TAIL);

        SearchResult sr;
        sr.article_id = readU32LE_buf(id_buf);
        sr.title      = String(title_buf);
        results.push_back(sr);
    }

    return results;
}

// ---------------------------------------------------------------------------
// Substring search — word index primary, sparse-index fallback
// ---------------------------------------------------------------------------

// Binary search word_index.bin for an exact word match.
// Returns the 0-based entry index, or -1 if not found.
static int32_t wordIndexFind(File &wf, const char *word) {
    if (!wf || g_word_entry_count == 0) return -1;
    int32_t lo = 0, hi = (int32_t)g_word_entry_count - 1;
    char buf[WORD_KEY_LEN + 1];
    while (lo <= hi) {
        int32_t mid = lo + (hi - lo) / 2;
        if (!wf.seek(8u + (uint32_t)mid * WORD_ENTRY_SIZE)) return -1;
        wf.read((uint8_t *)buf, WORD_KEY_LEN);
        buf[WORD_KEY_LEN] = '\0';
        int cmp = strncmp(buf, word, WORD_KEY_LEN - 1);
        if (cmp == 0) return mid;
        if (cmp < 0) lo = mid + 1; else hi = mid - 1;
    }
    return -1;
}

// Sparse-index fallback for when word_index.bin is not available.
static bool sparseKeyContains(int32_t si, const char *needle, int nlen) {
    const char *key = g_sparse_keys[si];
    for (int i = 0; i <= SPARSE_KEY_LEN - nlen; i++) {
        if (key[i] == 0) break;
        if (strncmp(key + i, needle, nlen) == 0) return true;
    }
    return false;
}

std::vector<SearchResult> wikiDbSearchContains(const String &query, int maxResults) {
    std::vector<SearchResult> results;
    if (!g_initialised || query.length() == 0) return results;

    String norm = normaliseKey(query);
    const char *nq   = norm.c_str();
    int         qlen = (int)norm.length();
    if (qlen == 0) return results;

    // ---- Word-index path (preferred) — open files locally to avoid holding FDs -
    if (g_word_entry_count > 0) {
        // Find the longest word (≥3 chars) in the query as the index lookup key.
        char best[WORD_KEY_LEN] = {};
        int  best_len = 0;
        const char *p = nq;
        while (*p) {
            while (*p == ' ') p++;
            const char *ws = p;
            while (*p && *p != ' ') p++;
            int wlen = (int)(p - ws);
            if (wlen >= 3 && wlen > best_len) {
                best_len = wlen < WORD_KEY_LEN ? wlen : WORD_KEY_LEN - 1;
                memcpy(best, ws, best_len);
                best[best_len] = '\0';
            }
        }
        if (best_len == 0) return results;

        // Temporarily close img handles to free 2 FD slots (limit=5, all taken).
        // Images are not loaded during search so this is safe.
        uint32_t saved_img_chunk_id = g_open_img_chunk_id;
        if (g_img_index_file) g_img_index_file.close();
        if (g_img_chunk_file) g_img_chunk_file.close();
        g_open_img_chunk_id = UINT32_MAX;

        File wf = SD.open(WORD_INDEX_PATH, FILE_READ);
        File tf = SD.open(TITLE_INDEX_PATH, FILE_READ);
        if (wf && tf) {
            int32_t entry_idx = wordIndexFind(wf, best);
            if (entry_idx >= 0) {
                wf.seek(8u + (uint32_t)entry_idx * WORD_ENTRY_SIZE + WORD_KEY_LEN);
                uint8_t tail[6];
                wf.read(tail, 6);
                uint32_t ids_start = readU32LE_buf(tail);
                uint16_t ids_count = (uint16_t)tail[4] | ((uint16_t)tail[5] << 8);

                wf.seek(g_word_ids_section_offset + ids_start * 4u);
                for (uint32_t i = 0; i < (uint32_t)ids_count && (int)results.size() < maxResults; i++) {
                    uint8_t id_buf[4];
                    wf.read(id_buf, 4);
                    uint32_t art_id = readU32LE_buf(id_buf);

                    if (!tf.seek(art_id * (uint32_t)TITLE_ENTRY_SIZE)) continue;
                    char title_buf[TITLE_ENTRY_SIZE];
                    tf.read((uint8_t *)title_buf, TITLE_ENTRY_SIZE);
                    title_buf[TITLE_ENTRY_SIZE - 1] = '\0';

                    if (strncmp(title_buf, nq, qlen) == 0) continue;  // prefix — skip
                    if (!strstr(title_buf, nq)) continue;

                    SearchResult sr;
                    sr.article_id = art_id;
                    sr.title      = String(title_buf);
                    results.push_back(sr);
                }
            }
        }
        if (wf) wf.close();
        if (tf) tf.close();

        // Reopen img handles.
        if (g_images_available) {
            g_img_index_file = SD.open(IMG_INDEX_PATH, FILE_READ);
            char img_path[32];
            snprintf(img_path, sizeof(img_path), IMG_CHUNK_FMT, saved_img_chunk_id);
            g_img_chunk_file = SD.open(img_path, FILE_READ);
            if (g_img_chunk_file) g_open_img_chunk_id = saved_img_chunk_id;
        }
        return results;
    }

    // ---- Sparse-index fallback (limited to titles whose first 12 chars match) -
    if (!g_sparse_keys || g_sparse_count == 0) return results;
    const char *sp = strchr(nq, ' ');
    int keyLen = sp ? (int)(sp - nq) : qlen;
    if (keyLen > SPARSE_KEY_LEN) keyLen = SPARSE_KEY_LEN;
    constexpr int TAIL = INDEX_RECORD_SIZE - TITLE_KEY_LEN - 4;
    int blocks_read = 0;
    for (int32_t si = 0; si < (int32_t)g_sparse_count && (int)results.size() < maxResults; si++) {
        if (strncmp(g_sparse_keys[si], nq, qlen < SPARSE_KEY_LEN ? qlen : SPARSE_KEY_LEN) == 0)
            continue;
        if (!sparseKeyContains(si, nq, keyLen)) continue;
        if (++blocks_read > 15) break;
        int32_t rec_start = si * (int32_t)g_sparse_step;
        int32_t rec_end   = min((int32_t)g_article_count, rec_start + (int32_t)g_sparse_step);
        g_index_file.seek((uint32_t)rec_start * INDEX_RECORD_SIZE);
        for (int32_t r = rec_start; r < rec_end && (int)results.size() < maxResults; r++) {
            char    title_buf[TITLE_KEY_LEN + 1];
            uint8_t id_buf[4]; uint8_t tail[TAIL];
            g_index_file.read((uint8_t *)title_buf, TITLE_KEY_LEN);
            title_buf[TITLE_KEY_LEN] = '\0';
            g_index_file.read(id_buf, 4);
            g_index_file.read(tail, TAIL);
            if (strncmp(title_buf, nq, qlen) == 0) continue;
            if (!strstr(title_buf, nq)) continue;
            SearchResult sr;
            sr.article_id = readU32LE_buf(id_buf);
            sr.title      = String(title_buf);
            results.push_back(sr);
        }
    }
    return results;
}

// ---------------------------------------------------------------------------
// Image loading
// ---------------------------------------------------------------------------

bool wikiDbImagesAvailable() {
    return g_images_available;
}

size_t wikiDbLoadImage(uint32_t img_id, uint8_t *buf, size_t buf_size) {
    if (!g_images_available) return 0;
    if (img_id >= g_image_count) {
        Serial.printf("[wiki_db] wikiDbLoadImage: id %u >= count %u\n", img_id, g_image_count);
        return 0;
    }
    if (!g_img_index_file.seek(img_id * 12)) {
        Serial.printf("[wiki_db] img_index seek failed for id=%u\n", img_id);
        return 0;
    }
    uint32_t chunk_id = readU32LE(g_img_index_file);
    uint32_t offset   = readU32LE(g_img_index_file);
    uint32_t length   = readU32LE(g_img_index_file);

    if (length == 0 || length > buf_size) {
        Serial.printf("[wiki_db] img id=%u length=%u buf_size=%u — skip\n",
                      img_id, length, (unsigned)buf_size);
        return 0;
    }

    if (chunk_id != g_open_img_chunk_id) {
        g_img_chunk_file.close();
        char path[32];
        snprintf(path, sizeof(path), IMG_CHUNK_FMT, chunk_id);
        g_img_chunk_file = SD.open(path, FILE_READ);
        if (!g_img_chunk_file) {
            Serial.printf("[wiki_db] Cannot open img chunk %s\n", path);
            g_open_img_chunk_id = UINT32_MAX;
            return 0;
        }
        g_open_img_chunk_id = chunk_id;
    }

    if (!g_img_chunk_file.seek(offset)) {
        Serial.printf("[wiki_db] img chunk seek failed id=%u offset=%u\n", img_id, offset);
        return 0;
    }
    if (!readExact(g_img_chunk_file, buf, length)) {
        Serial.printf("[wiki_db] img read failed id=%u length=%u\n", img_id, length);
        return 0;
    }
    uint32_t cs = 0;
    for (uint32_t k = 0; k < length; k++) cs = cs * 31 + buf[k];
    Serial.printf("[wiki_db] id=%u chunk=%u off=%u len=%u csum=0x%08X\n",
                  img_id, chunk_id, offset, length, cs);
    return length;
}

uint8_t *wikiDbScratchBuf(size_t *out_size) {
    if (out_size) *out_size = IMG_BUF_SIZE;
    return g_jpeg_buf;
}
